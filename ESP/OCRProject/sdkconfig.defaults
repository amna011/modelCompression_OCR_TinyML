## ESP/OCRProject/sdkconfig.defaults
```kconfig
# ESP32-S3-EYE Configuration
CONFIG_IDF_TARGET="esp32s3"

# Flash Configuration - ESP32-S3-EYE has 8MB flash
CONFIG_ESPTOOLPY_FLASHSIZE_8MB=y

# Custom Partition Table (3MB app partition)
CONFIG_PARTITION_TABLE_CUSTOM=y
CONFIG_PARTITION_TABLE_CUSTOM_FILENAME="partitions.csv"

# PSRAM Configuration for ESP32-S3-EYE
CONFIG_SPIRAM=y
CONFIG_SPIRAM_MODE_OCT=y
CONFIG_SPIRAM_SPEED_80M=y
CONFIG_SPIRAM_USE_MALLOC=y

# Optimize for size to reduce binary
CONFIG_COMPILER_OPTIMIZATION_SIZE=y
CONFIG_COMPILER_OPTIMIZATION_ASSERTIONS_DISABLE=y

# Reduce logging to save space
CONFIG_LOG_DEFAULT_LEVEL_WARN=y

# Camera optimizations
CONFIG_CAMERA_CORE0=y
```
